## app/west.yml
```yaml
manifest:
  remotes:
    - name: keychron
      url-base: https://github.com/Keychron
  projects:
    - name: zephyr
      remote: keychron
      revision: rtl87x2g
      clone-depth: 1
      import:
        name-blocklist:
          - ci-tools
          - hal_altera
          - hal_cypress
          - hal_infineon
          - hal_microchip
          - hal_nxp
          - hal_openisa
          - hal_silabs
          - hal_xtensa
          - hal_st
          - hal_ti
          - hal_ambiq
          - hal_atmel
          - hal_espressif
          - hal_ethos_u
          - hal_gigadevice
          - hal_intel
          - hal_nordic
          - hal_nuvoton
          - hal_quicklogic
          - hal_renesas
          - hal_rpi_pico
          - hal_telink
          - hal_wurthelektronik
          - hal_stm32
          - cmsis-dsp
          - cmsis-nn
          - fatfs
          - loramac-node
          - mcuboot
          - mcumgr
          - net-tools
          - openthread
          - edtt
          - trusted-firmware-m
    - name: nanopb
      revision: 8c60555d6277a0360c876bd85d491fc4fb0cd74a
      path: modules/lib/nanopb
      remote: zmkfirmware
    - name: zmk-studio-messages
      revision: 6cb4c283e76209d59c45fbcb218800cd19e9339d
      path: modules/msgs/zmk-studio-messages
      remote: zmkfirmware
  self:
    west-commands: scripts/west-commands.yml
```
